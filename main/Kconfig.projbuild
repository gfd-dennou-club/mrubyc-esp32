## main/Kconfig.projbuild
```kconfig
menu "mrubyc-esp32 Configuration"

  choice
    prompt "TIME ZONE"
    default TIME_ZONE_UTC

    config TIME_ZONE_UTC
        bool "UTC"
    config TIME_ZONE_JST
        bool "JST-9"
  endchoice

  config MRUBYC_TIMEZONE
    string
    default "UTC"   if TIME_ZONE_UTC
    default "JST-9" if TIME_ZONE_JST

  choice
    prompt "BOARD SELECT"
    default BOARD_ESP32
    config BOARD_ESP32
      bool "ESP32 Devkit series"      
    config BOARD_ESP32S3
      bool "ESP32 S3 Devkit series"
    config BOARD_M5BASIC
      bool "M5 stack Basic series"      
    config BOARD_M5CORE
      bool "M5 stack Core2/Core3 series"      
    config BOARD_ATOMLITE
      bool "Atom Lite series"
    config BOARD_ATOMS3
      bool "Atom S3 series"
  endchoice      

  config MRUBYC_I2C_PIN
    string
    default "ESP32 Devkit series"    if BOARD_ESP32
    default "ESP32 S3 Devkit series" if BOARD_ESP32S3
    default "Atom Lite series"       if BOARD_ATOMLITE
    default "Atom S3 series"         if BOARD_ATOMS3

  config USE_MRUBYC_HTTP_CAMERA
    bool "USE ESP-EYE CAMERA (idf.py add-dependency \"espressif/esp32-camera\")"
    default n

  choice MRBWRITE_TRANSPORT
    prompt "SPIFFS writer transport"
    default MRBWRITE_TRANSPORT_WIRED
  config MRBWRITE_TRANSPORT_WIRED
    bool "USB Serial/JTAG or UART"
  config MRBWRITE_TRANSPORT_BLE
    bool "Bluetooth LE (ChromeOS Web Bluetooth)"
  endchoice
  config MRBWRITE_BLE_DEVICE_NAME
    string "BLE device name"
    default "Kani-Board-BLE"
    depends on MRBWRITE_TRANSPORT_BLE
    
endmenu
```
